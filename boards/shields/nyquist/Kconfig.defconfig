## boards/shields/nyquist/Kconfig.defconfig
```kconfig
# SPDX-License-Identifier: MIT

if SHIELD_NYQUIST_LEFT

config ZMK_KEYBOARD_NAME
    default "Nyquist"

config ZMK_SPLIT_ROLE_CENTRAL
    default y

endif

if SHIELD_NYQUIST_LEFT || SHIELD_NYQUIST_RIGHT

config ZMK_SPLIT
    default y

endif

if ZMK_BACKLIGHT

config PWM
    default y

config LED_PWM
    default y

endif # ZMK_BACKLIGHT
```

## boards/shields/nyquist/Kconfig.shield
```kconfig
# SPDX-License-Identifier: MIT

config SHIELD_NYQUIST_LEFT
    def_bool $(shields_list_contains,nyquist_left)

config SHIELD_NYQUIST_RIGHT
    def_bool $(shields_list_contains,nyquist_right)
```
